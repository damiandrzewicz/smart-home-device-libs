## mqtt_wrapper/Kconfig.projbuild
```kconfig
menu "MQTT Configuration"

    config BROKER_URL
        string "Broker URL"
        default "mqtt://mqtt.eclipse.org"
        help
            URL of the broker to connect to.

    config BROKER_USE_PASSWORD
        bool "Use login and password"
        default n
        help
            This allows you to skip login and password.

    config BROKER_USE_SSL
        bool "Use SLL auth"
        default n
        help
            This allows you to use SSL auth

    config BROKER_LOGIN
        string "Broker Login"
        default "test"
        help
            Login used to connect to the broker.

    config BROKER_PASSWORD
        string "Broker Password"
        default "test123"
        help
            Password used to connect to the broker.

endmenu
```

## network_wrapper/Kconfig.projbuild
```kconfig
menu "Wifi Configuration"

    config WIFI_SSID
        string "WiFi SSID"
        default "myssid"
        help
            SSID (network name) for the example to connect to.

    config WIFI_PASSWORD
        string "WiFi Password"
        default "mypassword"
        help
            WiFi password (WPA or WPA2) for the example to use.
            Can be left blank if the network has no security set.
endmenu

# menu "MQTT Configuration"

#     config MQTT_BROKER_URL
#         string "MQTT Broker URL"
#         default "url"
#         help
#             URL to reach MQTT broker.

#     config MQTT_BROKER_USERNAME
#         string "MQTT Broker Username"
#         default "username"
#         help
#             Username to authenticate MQTT broker.

#     config MQTT_BROKER_PASSWORD
#         string "MQTT Broker Password"
#         default "mypassword"
#         help
#             Password to authenticate MQTT broker.
# endmenu
```
